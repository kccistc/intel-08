## Team6/meta-AIBlackBox/conf/layer.conf
```bitbake
# We have a conf and classes directory, add to BBPATH
BBPATH .= ":${LAYERDIR}"

# We have recipes-* directories, add to BBFILES
BBFILES += "\
  ${LAYERDIR}/recipes-*/*/*.bb \
  ${LAYERDIR}/recipes-*/*/*.bbappend \
  ${LAYERDIR}/recipes-*/*.bb \
  ${LAYERDIR}/recipes-*/*.bbappend \
"

BBFILE_COLLECTIONS += "meta-AIBlackBox"
BBFILE_PATTERN_meta-AIBlackBox = "^${LAYERDIR}/"
BBFILE_PRIORITY_meta-AIBlackBox = "6"

LAYERDEPENDS_meta-AIBlackBox = "core"
LAYERSERIES_COMPAT_meta-AIBlackBox = "kirkstone"
```
